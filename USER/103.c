/*****************************************************************************

*****************************************************************************/
#include  "string.h"
#include  "delay.h"
#include  "SX1276.h"
#include  "core_cm3.h"
#include  "103.h"
#include  "led.h"
#include  "bsp_usart.h"  
#include "config.h"
#include "stmflash.h"

u8 air_flash_buff[80];//存上电读flash的数据
u8 channel_flash_buff[30];//
u8 localAddr=3;//从机地址
void UART_Send(u8 *str,u8 len3);//串口4发送
void checkComm0Modbus(void);//CRC校验
/*无线数据解析*/
//typedef struct wuxian
//{
//   
//    void ( *GetRxPacket )(void);
//    void ( *SetTxPacket )(void);
//   // uint32_t ( *Process )(void);
//}wuxian;
//wuxian *sx1278=NULL;
const u8 auchCRCHi[] = { 
0x00, 0xC1, 0x81, 0x40, 0x01, 0xC0, 0x80, 0x41, 0x01, 0xC0,0x80, 0x41, 0x00, 0xC1, 0x81, 0x40, 0x01, 0xC0, 0x80, 0x41, 
0x00, 0xC1, 0x81, 0x40, 0x00, 0xC1, 0x81, 0x40, 0x01, 0xC0,0x80, 0x41, 0x01, 0xC0, 0x80, 0x41, 0x00, 0xC1, 0x81, 0x40, 
0x00, 0xC1, 0x81, 0x40, 0x01, 0xC0, 0x80, 0x41, 0x00, 0xC1,0x81, 0x40, 0x01, 0xC0, 0x80, 0x41, 0x01, 0xC0, 0x80, 0x41, 
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0x00, 0xC1, 0x81, 0x40, 0x01, 0xC0, 0x80, 0x41, 0x01, 0xC0,0x80, 0x41, 0x00, 0xC1, 0x81, 0x40} ; 


const u8 auchCRCLo[] = { 
0x00, 0xC0, 0xC1, 0x01, 0xC3, 0x03, 0x02, 0xC2, 0xC6, 0x06,0x07, 0xC7, 0x05, 0xC5, 0xC4, 0x04, 0xCC, 0x0C, 0x0D, 0xCD, 
0x0F, 0xCF, 0xCE, 0x0E, 0x0A, 0xCA, 0xCB, 0x0B, 0xC9, 0x09,0x08, 0xC8, 0xD8, 0x18, 0x19, 0xD9, 0x1B, 0xDB, 0xDA, 0x1A, 
0x1E, 0xDE, 0xDF, 0x1F, 0xDD, 0x1D, 0x1C, 0xDC, 0x14, 0xD4,0xD5, 0x15, 0xD7, 0x17, 0x16, 0xD6, 0xD2, 0x12, 0x13, 0xD3, 
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0x44, 0x84, 0x85, 0x45, 0x87, 0x47, 0x46, 0x86, 0x82, 0x42,0x43, 0x83, 0x41, 0x81, 0x80, 0x40} ;
u16   crc16(u8 *puchMsg, u16 usDataLen) //*puchMsg???CRC????? 
{                                               // usDataLen??????
	u8 uchCRCHi = 0xFF ;/*高CRC字节初始化*/ 
 	u8 uchCRCLo = 0xFF ; /*低CRC字节初始化*/
	u32 uIndex ; 
	while (usDataLen--) 
	{ 
		uIndex =uchCRCHi ^ *puchMsg++ ; //异或
		uchCRCHi = uchCRCLo ^ auchCRCHi[uIndex] ; 
		uchCRCLo = auchCRCLo[uIndex] ; 
	} 
	return (uchCRCHi<<8|uchCRCLo) ; 
}//uint16 crc16(uint8 *puchMsg, uint16 usDataLen)



/*串口2发送*/
void UART_Send(u8 *str,u8 len3)
{
	 u8 i;
	 while(USART_GetFlagStatus(USART1, USART_FLAG_TC) == RESET);	
   for(i=0;i<len3;i++)
	{
  		USART_SendData(USART1, *(str+i));
	   while(USART_GetFlagStatus(USART1,USART_FLAG_TC)==RESET);  //while这个时间等的很久数据还没发出去  已经是下一个中断了
     //USART_SendData(UART4, r\n);	  //可像之前IAR程序那样多发一个数据尝试
	}
}





/*LORA接收数据后发送*/
void jieshou_handle(void) 
{
	//delay_ms(10);//1.10189ms
	sx1278send(0x0d);   
	
	if(SX1276ReadData(REG_LR_IRQFLAGS))  //读0x12寄存器---收到下面的ＬＯＲＡ回的数据
	 { 
     GetRxPacket();
                      //;//以10KHZ的频率计数 计数到5000为500ms  //进去后要关下定时器
   }                 //发送过后读一下0x12寄存器
}

void GetRxPacket(void)
{
    RF_EX0_STATUS=SX1276ReadData(REG_LR_IRQFLAGS);
  	if((RF_EX0_STATUS&0x08)==0x08)  //发射完成
	  {//发射完成后,置为接收模式
		 // SX1276LoRaSetOpMode(stdby_mode );
		 SX1276WriteData(REG_LR_IRQFLAGSMASK,IRQN_RXD_Value);	        //??????
		 SX1276WriteData(REG_LR_HOPPERIOD,   PACKET_MIAX_Value );      //0x24???,???????????
		 SX1276WriteData( REG_LR_DIOMAPPING1, 0X00 );
		 SX1276WriteData( REG_LR_DIOMAPPING2, 0x00 );	
		 SX1276LoRaSetOpMode(Recevived_mode);
		 SX1276WriteData( REG_LR_FIFOTXBASEADDR, 0);           //?Tx FIFO??
	   SX1276WriteData( REG_LR_FIFOADDRPTR, 0 ); 		
	  }
		SX1276WriteData(REG_LR_IRQFLAGS,0xff);//
}


/*
 * 函数名：void air_Read_flash(void)
 * 描述  ：读Flash  空速值
 * 输入  ：无
 * 输出  ：无	
 */
void air_Read_flash(void)
{
 STMFLASH_Read(Read_air_spped_ADDR,(u16*)air_flash_buff,3); //上电读flash数据重新赋值给rate_buff
 rate_buff[0].SpreadingFactor=(u8)(air_flash_buff[0]);//读出的榔狄蜃�
 rate_buff[0].CodingRate=(u8)(air_flash_buff[1]);//读出的纠错率
 rate_buff[0].Bw_Frequency=(u8)(air_flash_buff[2]);//读出的带宽	
 //crc_flash=flash_buff[1]+(flash_buff[0]<<8);
}


/*
 * 函数名：u8 read_air_speed(void);
 * 描述  ：读Flash  空速值
 * 输入  ：无
 * 输出  ：无	
 */
u8 read_air_speed(unsigned char bps)
{
	STMFLASH_Read(Read_air_spped_ADDR,(u16*)air_flash_buff,3); //上电读flash数据重新赋值给rate_buff
	datatemp[0].SpreadingFactor=(u8)(air_flash_buff[0]);//
  datatemp[0].CodingRate=(u8)(air_flash_buff[1]);//
  datatemp[0].Bw_Frequency=(u8)(air_flash_buff[2]);//
 if((datatemp[0].SpreadingFactor==7)&&(datatemp[0].CodingRate==1)&&(datatemp[0].Bw_Frequency==9))
	 {return (bps<<3)|5;}//19.2K
 if((datatemp[0].SpreadingFactor==7)&&(datatemp[0].CodingRate==4)&&(datatemp[0].Bw_Frequency==9))
	 {return (bps<<3)|4;}//9.6K
 if(datatemp[0].SpreadingFactor==9&&datatemp[0].CodingRate==3&&datatemp[0].Bw_Frequency==9)
	 {return (bps<<3)|3;}  //4.8K
 if(datatemp[0].SpreadingFactor==7&&datatemp[0].CodingRate==2&&datatemp[0].Bw_Frequency==7)
	 {return (bps<<3)|2;}  //2.4K
 if(datatemp[0].SpreadingFactor==10&&datatemp[0].CodingRate==4&&datatemp[0].Bw_Frequency==9)
	 {return (bps<<3)|1;}//1.2K
 if(datatemp[0].SpreadingFactor==12&&datatemp[0].CodingRate==1&&datatemp[0].Bw_Frequency==9)
	 {return (bps<<3)|0;}  //0.3K
	else
	{
	 return 0x00;
	}
}

/*
 * 函数名：u8 read_channel(void)
 * 描述  ：读Flash  信道值
 * 输入  ：无
 * 输出  ：无	
 */
u8 read_channel(void)
{
	STMFLASH_Read(Read_chnnel_ADDR,(u16*)channel_flash_buff,1); //上电读flash数据重新赋值给rate_buff
  return  ((u8)(channel_flash_buff[0]));// 
}

/*
 * 函数名：u8 read_channel_temp(void)
 * 描述  ：读Flash  设置默认频段值
 * 输入  ：无
 * 输出  ：无	
 */
u8 read_channel_temp(void)
 {
   //static int channel_temp=0x17;
	 STMFLASH_Read(Read_channel_temp_ADDR ,(u16*)&channel_flash_buff[15],1);
	 return  ((u8)(channel_flash_buff[15]));
 }
 	


